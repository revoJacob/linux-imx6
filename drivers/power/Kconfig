## drivers/power/Kconfig
```kconfig
config BATTERY_MAX77696
	tristate "Maxim MAX77696 Fuel Gauge"
	depends on MFD_MAX77696
	help
	  Say Y to include support for Maxim MAX77696 Fuel Gauge.

config CHARGER_MAX77696
	tristate "Maxim MAX77696 Charger"
	depends on MFD_MAX77696
	help
	  Say Y to include support for Maxim MAX77696 Main Battery Charger.

config EH_MAX77696
	tristate "Maxim MAX77696 Energy Harvester"
	depends on MFD_MAX77696
	help
	  Say Y to include support for Maxim MAX77696 Energy Harvester.

source "drivers/power/avs/Kconfig"
source "drivers/power/reset/Kconfig"
source "drivers/power/supply/Kconfig"
```
